#include <Wire.h>
#include <Adafruit_GFX.h>
#include <Adafruit_SSD1306.h>

#define SCREEN_WIDTH 128
#define SCREEN_HEIGHT 64

// Pins
#define SDA_PIN D2
#define SCL_PIN D1
#define TOUCH_LEFT D6
#define TOUCH_RIGHT D5
#define BUTTON_PIN D7

// QMC5883
#define QMC5883_ADDR 0x0D

Adafruit_SSD1306 display(SCREEN_WIDTH, SCREEN_HEIGHT, &Wire, -1);

// Game States
enum GameState {
  MENU,
  PONG,
  BREAKOUT,
  SLEEP
};

GameState currentState = MENU;

// Magnetometer
int16_t x, y, z;
int16_t lastX, lastY, lastZ;
bool firstRead = true;
unsigned long stableStart = 0;
bool sleeping = false;

const int threshold = 100;
const unsigned long sleepDelay = 8000;

// Touch & Button
unsigned long lastTouchTime = 0;
bool leftTouchPrev = false;
bool rightTouchPrev = false;
bool leftSelected = false;
bool rightSelected = false;

// ==================== SLEEP BITMAP ====================
static const unsigned char PROGMEM image_images__1__bits[] = {0x1c,0x00,0x00,0x00,0x00,0x00,0x01,0xc0,0x00,0x00,0x00,0x00,0x00,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0x00,0x00};

// ==================== PONG VARIABLES ====================
int playerPaddleX = 50;
int botPaddleX = 50;
int paddleWidth = 28;
int paddleHeight = 4;
int ballX = 64, ballY = 32;
int ballDX = 2, ballDY = -2;
int pongScore = 0;
unsigned long pongLastFrame = 0;

// ==================== BREAKOUT VARIABLES ====================
int breakoutPaddleX = 50;
int breakoutBallX = 64, breakoutBallY = 40;
int breakoutBallDX = 2, breakoutBallDY = -2;
int breakoutScore = 0;
int lives = 3;
bool bricks[8][4];
bool breakoutGameOver = false;
unsigned long breakoutLastFrame = 0;

// ================================================================

void setup() {
  Serial.begin(115200);
  
  pinMode(TOUCH_LEFT, INPUT);
  pinMode(TOUCH_RIGHT, INPUT);
  pinMode(BUTTON_PIN, INPUT_PULLUP);

  Wire.begin(SDA_PIN, SCL_PIN);

  if (!display.begin(SSD1306_SWITCHCAPVCC, 0x3C)) {
    while (1);
  }

  display.clearDisplay();
  display.display();

  initQMC5883();
  initBricks();
  showWake();
  Serial.println("Ready");
}

void loop() {
  readMag();
  handleSleep();
  handleInput();

  switch (currentState) {
    case MENU:      drawMenu();      break;
    case PONG:      playPong();      break;
    case BREAKOUT:  playBreakout();  break;
    case SLEEP:     break;
  }
  delay(20);
}

// ==================== SLEEP SYSTEM ====================
void handleSleep() {
  if (currentState == PONG || currentState == BREAKOUT) return;

  int movement = abs(x - lastX) + abs(y - lastY) + abs(z - lastZ);
  if (movement > threshold) {
    stableStart = millis();
    if (sleeping) {
      sleeping = false;
      showWake();
      currentState = MENU;
    }
  } else if (!sleeping && millis() - stableStart >= sleepDelay) {
    sleeping = true;
    currentState = SLEEP;
    showSleep();
  }
  lastX = x; lastY = y; lastZ = z;
}

void showWake() {
  display.clearDisplay();
  display.setTextSize(2);
  display.setTextColor(SSD1306_WHITE);
  display.setCursor(25, 20);
  display.println("WAKE UP");
  display.display();
  delay(800);
}

void showSleep() {
    display.clearDisplay();
  display.drawBitmap(-86, -37, image_images__1__bits, 217, 122, 1);
  display.display();
}

// ==================== MENU ====================
void drawMenu() {
  display.clearDisplay();
  display.drawFastVLine(64, 0, 64, SSD1306_WHITE);

  if (leftSelected) {
    display.fillRect(0, 0, 63, 64, SSD1306_WHITE);
    display.setTextColor(SSD1306_BLACK);
  } else display.setTextColor(SSD1306_WHITE);
  display.setTextSize(1);
  display.setCursor(15, 15);
  display.println("PONG");

  if (rightSelected) {
    display.fillRect(65, 0, 63, 64, SSD1306_WHITE);
    display.setTextColor(SSD1306_BLACK);
  } else display.setTextColor(SSD1306_WHITE);
  display.setCursor(72, 15);
  display.println("BREAK");
  display.setCursor(72, 30);
  display.println("THE ICE");

  display.display();
}

void handleInput() {
  bool leftTouch = digitalRead(TOUCH_LEFT);
  bool rightTouch = digitalRead(TOUCH_RIGHT);
  bool button = !digitalRead(BUTTON_PIN);

  if (leftTouch && !leftTouchPrev) { leftSelected = true; rightSelected = false; }
  if (rightTouch && !rightTouchPrev) { rightSelected = true; leftSelected = false; }

  if (leftTouch && rightTouch && millis() - lastTouchTime > 400) {
    currentState = MENU;
    leftSelected = rightSelected = false;
    lastTouchTime = millis();
  }

  if (button) {
    if (leftSelected) currentState = PONG;
    if (rightSelected) currentState = BREAKOUT;
    delay(200);
  }

  leftTouchPrev = leftTouch;
  rightTouchPrev = rightTouch;
}

// ==================== PONG WITH BOT ====================
void playPong() {
  if (millis() - pongLastFrame < 35) return;
  pongLastFrame = millis();

  display.clearDisplay();

  // Player Paddle (Bottom)
  if (digitalRead(TOUCH_LEFT)) playerPaddleX -= 4;
  if (digitalRead(TOUCH_RIGHT)) playerPaddleX += 4;
  playerPaddleX = constrain(playerPaddleX, 0, SCREEN_WIDTH - paddleWidth);

  // Simple Bot Paddle (Top) - AI
  botPaddleX = botPaddleX + (ballX - (botPaddleX + paddleWidth/2)) * 0.18;
  botPaddleX = constrain(botPaddleX, 0, SCREEN_WIDTH - paddleWidth);

  // Ball Movement
  ballX += ballDX;
  ballY += ballDY;

  // Wall Bounce
  if (ballX <= 2 || ballX >= SCREEN_WIDTH - 4) ballDX = -ballDX;

  // Top Paddle (Bot) Bounce
  if (ballY <= 6 && ballX >= botPaddleX && ballX <= botPaddleX + paddleWidth) {
    ballDY = abs(ballDY);  // Go down
  }

  // Bottom Paddle (Player) Bounce
  if (ballY >= 56 && ballX >= playerPaddleX && ballX <= playerPaddleX + paddleWidth) {
    ballDY = -abs(ballDY);
    pongScore++;
  }

  // Miss (Reset)
  if (ballY > SCREEN_HEIGHT || ballY < 0) {
    resetPong();
  }

  // Draw
  display.fillRect(playerPaddleX, 58, paddleWidth, paddleHeight, SSD1306_WHITE); // Player
  display.fillRect(botPaddleX, 2, paddleWidth, paddleHeight, SSD1306_WHITE);     // Bot
  display.fillRect(ballX, ballY, 4, 4, SSD1306_WHITE);

  display.setTextSize(1);
  display.setCursor(4, 20);
  display.print("Score: ");
  display.print(pongScore);

  display.display();
}

void resetPong() {
  ballX = 64; ballY = 32;
  ballDX = random(1, 4) * (random(0, 2) ? 1 : -1);
  ballDY = -2;
  playerPaddleX = 50;
  botPaddleX = 50;
  pongScore = 0;
}

// ==================== BREAKOUT WITH LIVES ====================
void initBricks() {
  for (int i = 0; i < 8; i++)
    for (int j = 0; j < 4; j++)
      bricks[i][j] = true;
}

void playBreakout() {
  if (millis() - breakoutLastFrame < 35) return;
  breakoutLastFrame = millis();

  display.clearDisplay();

  // Paddle Control
  if (digitalRead(TOUCH_LEFT)) breakoutPaddleX -= 4;
  if (digitalRead(TOUCH_RIGHT)) breakoutPaddleX += 4;
  breakoutPaddleX = constrain(breakoutPaddleX, 0, SCREEN_WIDTH - 32);

  // Ball Movement
  breakoutBallX += breakoutBallDX;
  breakoutBallY += breakoutBallDY;

  // Walls
  if (breakoutBallX <= 2 || breakoutBallX >= SCREEN_WIDTH - 4) breakoutBallDX = -breakoutBallDX;
  if (breakoutBallY <= 2) breakoutBallDY = -breakoutBallDY;

  // Paddle Bounce
  if (breakoutBallY >= 56 && breakoutBallY <= 60 && 
      breakoutBallX >= breakoutPaddleX && breakoutBallX <= breakoutPaddleX + 32) {
    breakoutBallDY = -abs(breakoutBallDY);
  }

  // Brick Collision
  for (int i = 0; i < 8; i++) {
    for (int j = 0; j < 4; j++) {
      if (bricks[i][j]) {
        int bx = i * 16 + 2;
        int by = j * 8 + 2;
        if (breakoutBallX >= bx && breakoutBallX <= bx + 13 && 
            breakoutBallY >= by && breakoutBallY <= by + 6) {
          bricks[i][j] = false;
          breakoutBallDY = -breakoutBallDY;
          breakoutScore += 10;
        }
      }
    }
  }

  // Miss - Lose Life
  if (breakoutBallY > SCREEN_HEIGHT) {
    lives--;
    if (lives <= 0) {
      breakoutGameOver = true;
    } else {
      // Reset ball position only
      breakoutBallX = 64;
      breakoutBallY = 40;
      breakoutBallDX = 2;
      breakoutBallDY = -2;
    }
  }

  // Draw Bricks
  for (int i = 0; i < 8; i++) {
    for (int j = 0; j < 4; j++) {
      if (bricks[i][j]) {
        display.fillRect(i*16 + 2, j*8 + 2, 13, 6, SSD1306_WHITE);
      }
    }
  }

  // Draw Paddle & Ball
  display.fillRect(breakoutPaddleX, 58, 32, 4, SSD1306_WHITE);
  display.fillRect(breakoutBallX, breakoutBallY, 4, 4, SSD1306_WHITE);

  // HUD
  display.setTextSize(1);
  display.setCursor(4, 4);
  display.print("Score:");
  display.print(breakoutScore);
  display.setCursor(90, 4);
  display.print("L:");
  display.print(lives);

  if (breakoutGameOver) {
    display.setTextSize(2);
    display.setCursor(18, 22);
    display.println("GAME");
    display.setCursor(28, 42);
    display.println("OVER");
  }

  display.display();

  // Hold both sensors to return to menu
  if (digitalRead(TOUCH_LEFT) && digitalRead(TOUCH_RIGHT)) {
    delay(400);
    currentState = MENU;
    resetBreakout();
  }
}

void resetBreakout() {
  breakoutBallX = 64; breakoutBallY = 40;
  breakoutBallDX = 2; breakoutBallDY = -2;
  breakoutScore = 0;
  lives = 3;
  breakoutGameOver = false;
  initBricks();
}

// ==================== MAGNETOMETER ====================
void initQMC5883() {
  Wire.beginTransmission(QMC5883_ADDR);
  Wire.write(0x0B); Wire.write(0x01); Wire.endTransmission();
  delay(10);
  Wire.beginTransmission(QMC5883_ADDR);
  Wire.write(0x09); Wire.write(0x1D); Wire.endTransmission();
  delay(10);
}

void readMag() {
  Wire.beginTransmission(QMC5883_ADDR);
  Wire.write(0x00);
  Wire.endTransmission(false);
  Wire.requestFrom(QMC5883_ADDR, 6);
  if (Wire.available() >= 6) {
    x = Wire.read() | (Wire.read() << 8);
    y = Wire.read() | (Wire.read() << 8);
    z = Wire.read() | (Wire.read() << 8);
  }
}