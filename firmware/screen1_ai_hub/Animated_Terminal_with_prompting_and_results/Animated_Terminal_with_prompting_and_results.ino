#include <WiFi.h>
#include <WebServer.h>
#include <Wire.h>
#include <Adafruit_GFX.h>
#include <Adafruit_SSD1306.h>

#define SCREEN_WIDTH 128
#define SCREEN_HEIGHT 64
#define OLED_RESET    -1
Adafruit_SSD1306 display(SCREEN_WIDTH, SCREEN_HEIGHT, &Wire, OLED_RESET);
WebServer server(80);

const char* ssid     = "dp_23-4G";
const char* password = "jainil517";

const int PIN_LEFT   = 26;
const int PIN_RIGHT  = 27;
const int PIN_SELECT = 14;
const int PIN_SEND   = 12;

const char keyboard[] = "ABCDEFGHIJKLMNOPQRSTUVWXYZ .,?"; 
const int TOTAL_CHARS = 30;

int cursorIndex = 0;
String currentPrompt = "";
bool promptReadyToSend = false;

unsigned long selectTouchTime = 0;
bool isSelectPressed = false;
bool holdActionTriggered = false;

bool leftLatched = false;
bool rightLatched = false;
bool sendLatched = false;

String currentText = "";
bool newTextAvailable = false;
const int SCROLL_SPEED_DELAY = 35; 
const int LINE_HEIGHT = 10;        
String lines[120]; 
int lineCount = 0;

enum SystemState { TYPING_PROMPT, WAITING_FOR_AI, SCROLLING_RESPONSE };
SystemState currentState = TYPING_PROMPT;

void handleGetPrompt() {
  server.sendHeader("Access-Control-Allow-Origin", "*");
  if (promptReadyToSend) {
    server.send(200, "text/plain", currentPrompt);
    currentPrompt = ""; // Clear screen immediately after data is requested by laptop
    promptReadyToSend = false;
  } else {
    server.send(200, "text/plain", ""); 
  }
}

void handlePostData() {
  server.sendHeader("Access-Control-Allow-Origin", "*");
  server.sendHeader("Access-Control-Allow-Methods", "POST,GET,OPTIONS");
  server.sendHeader("Access-Control-Allow-Headers", "Content-Type");

  if (server.method() == HTTP_OPTIONS) {
    server.send(200, "text/plain", "");
    return;
  }

  if (server.hasArg("plain")) {
    currentText = server.arg("plain");
    currentText.trim();
    
    currentText.replace("\n", " ");
    currentText.replace("\r", " ");
    while(currentText.indexOf("  ") >= 0) {
      currentText.replace("  ", " ");
    }
    
    newTextAvailable = true; 
    server.send(200, "text/plain", "Data Received");
  }
}

void wrapTextToArray(String text, int maxCharsPerLine) {
  lineCount = 0;
  int textLength = text.length();
  int currentPos = 0;

  while (currentPos < textLength && lineCount < 120) {
    if (currentPos + maxCharsPerLine >= textLength) {
      lines[lineCount] = text.substring(currentPos);
      lineCount++;
      break;
    }

    int spaceIdx = text.lastIndexOf(' ', currentPos + maxCharsPerLine);

    if (spaceIdx > currentPos) {
      lines[lineCount] = text.substring(currentPos, spaceIdx);
      currentPos = spaceIdx + 1; 
    } else {
      lines[lineCount] = text.substring(currentPos, currentPos + maxCharsPerLine);
      currentPos += maxCharsPerLine;
    }
    lineCount++;
  }
}

void smoothScrollText() {
  int totalScrollHeight = lineCount * LINE_HEIGHT;

  for (int scrollPos = SCREEN_HEIGHT; scrollPos > -totalScrollHeight; scrollPos--) {
    server.handleClient(); 
    
    display.clearDisplay();
    display.setTextWrap(false);
    for (int i = 0; i < lineCount; i++) {
      int lineYPos = scrollPos + (i * LINE_HEIGHT);
      if (lineYPos > -LINE_HEIGHT && lineYPos < SCREEN_HEIGHT) {
        display.setCursor(0, lineYPos);
        display.print(lines[i]);
      }
    }
    display.display();
    delay(SCROLL_SPEED_DELAY);
  }
}
static const unsigned char PROGMEM image_DolphinMafia_bits[] = {0x00,0x00,0x00,0x00,0x0f,0xfc,0x00,0x00,0x00,0x00,0x00,0x00,0x00,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0x00,0x00};static const unsigned char PROGMEM image_paint_2_bits[] = {0x00,0x04,0x00,0x00,0x40,0x04,0x00,0x00,0x40,0x04,0x00,0x00,0x40,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0x02,0x00};
static const unsigned char PROGMEM image_BLE_Pairing_bits[] = {0x00,0x00,0x00,0x00,0x00,0x00,0x00,0x00,0x00,0x00,0x00,0x00,0x00,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0x00,0x68};
  
// [BEGIN lopaka generated]

static const unsigned char PROGMEM image_Attention_bits[] = {0x70,0x50,0x50,0x50,0x70,0x20,0x00,0x70};

static const unsigned char PROGMEM image_DoorRight_bits[] = {0x10,0x20,0x04,0x00,0x00,0x00,0x00,0x00,0x00,0x00,0x00,0x00,0x00,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0x3f,0xc0};

static const unsigned char PROGMEM image_DoorRight_copy_1_bits[] = {0x00,0x00,0x20,0x04,0x08,0x00,0x00,0x00,0x00,0x00,0x01,0x78,0x00,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0x00,0x01};

static const unsigned char PROGMEM image_Drive_bits[] = {0x07,0xff,0xff,0xff,0xff,0xff,0xff,0xff,0xff,0xff,0xf8,0x00,0x00,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0x00,0x00};

static const unsigned char PROGMEM image_Exp_module_connected_bits[] = {0x1f,0xc0,0x1f,0xc0,0x1f,0xc0,0x0a,0x80,0x1f,0xc0,0x20,0x20,0x5e,0xd0,0x9e,0xd0};

static const unsigned char PROGMEM image_Hashmark_bits[] = {0x14,0x14,0x7e,0x28,0xfc,0x50,0x50};

static const unsigned char PROGMEM image_Hidden_window_bits[] = {0x7f,0x80,0x7e,0x80,0x7f,0x80,0x40,0x80,0xfe,0x80,0x82,0x80,0x83,0x80,0xfe,0x00};

static const unsigned char PROGMEM image_music_sound_wave_bits[] = {0x00,0x00,0x00,0x02,0x00,0x00,0x02,0x20,0x00,0x02,0x20,0x00,0x02,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0x00,0x00};

static const unsigned char PROGMEM image_network_www_bits[] = {0x03,0xc0,0x0d,0xb0,0x32,0x4c,0x24,0x24,0x44,0x22,0x7f,0xfe,0x88,0x11,0x88,0x11,0x88,0x11,0x88,0x11,0x7f,0xfe,0x44,0x22,0x24,0x24,0x32,0x4c,0x0d,0xb0,0x03,0xc0};

static const unsigned char PROGMEM image_passport_left_bits[] = {0x3c,0x40,0x98,0xa4,0xa4,0x98,0x80,0x80,0xa0,0x90,0x88,0xa4,0x90,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0x4c,0x4c};

static const unsigned char PROGMEM image_passport_left_copy_1_bits[] = {0xf0,0x08,0x64,0x94,0x94,0x64,0x04,0x04,0x14,0x24,0x44,0x94,0x24,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0xc8,0xc8};

static const unsigned char PROGMEM image_RFIDBigChip_bits[] = {0x60,0x00,0x00,0x00,0x00,0x67,0xff,0xff,0xff,0xe0,0x48,0x00,0x00,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0xff,0xe0};

static const unsigned char PROGMEM image_Rpc_active_bits[] = {0xe0,0xac,0xe2,0x02,0x80,0x8e,0x6a,0x0e};

static const unsigned char PROGMEM image_SDcardMounted_bits[] = {0xff,0xe0,0xff,0x20,0xff,0xe0,0xff,0x20,0xff,0xe0,0xff,0x20,0xff,0xe0,0xe6,0x00};


void drawScreen_1(void) {

    display.clearDisplay();

    
    display.drawBitmap(0, 7, image_DolphinMafia_bits, 119, 62, 1);

    
    display.setTextColor(1);
    display.setTextWrap(false);
    display.setCursor(77, 22);
    display.print("Terminal");

    
    display.setCursor(100, 1);
    display.print("Dual");

    display.setCursor(88, 12);
    display.print("BINARY");

    display.display();
}

void drawScreen_2(void) {

    display.clearDisplay();

    display.drawBitmap(46, 14, image_RFIDBigChip_bits, 37, 36, 1);

    display.drawBitmap(40, 7, image_passport_left_bits, 6, 46, 1);

    display.drawBitmap(83, 7, image_passport_left_copy_1_bits, 6, 46, 1);

    display.drawLine(46, 7, 84, 7, 1);

    display.drawBitmap(18, 52, image_Drive_bits, 112, 35, 1);

    display.drawBitmap(0, 3, image_DoorRight_bits, 40, 47, 1);

    display.drawBitmap(89, 3, image_DoorRight_copy_1_bits, 40, 47, 1);

    display.drawBitmap(23, 54, image_Exp_module_connected_bits, 12, 8, 1);

    display.drawBitmap(40, 54, image_Hidden_window_bits, 9, 8, 1);

    display.drawLine(34, 5, 93, 5, 1);

    display.drawBitmap(55, 54, image_Rpc_active_bits, 7, 8, 1);

    display.drawBitmap(68, 54, image_SDcardMounted_bits, 11, 8, 1);

    display.drawBitmap(85, 54, image_Hashmark_bits, 7, 7, 1);

    display.drawBitmap(98, 54, image_Attention_bits, 5, 8, 1);

    display.drawBitmap(1, 47, image_network_www_bits, 16, 16, 1);

    display.drawBitmap(108, 43, image_music_sound_wave_bits, 17, 16, 1);

    display.display();
}

void drawScreen_3(void){
    display.clearDisplay();
  
  int midX = SCREEN_WIDTH / 2;
  int midY = SCREEN_HEIGHT / 2;

  display.drawPixel(midX, midY, WHITE);
  display.display();
  delay(400);

  for (int w = 1; w <= SCREEN_WIDTH; w += 8) {
    display.clearDisplay();
    int startX = midX - (w / 2);
    display.drawFastHLine(startX, midY, w, WHITE);
    display.display();
    delay(15); 
  }
  delay(100); 

  for (int h = 1; h <= SCREEN_HEIGHT; h += 4) {
    display.clearDisplay();
    int startY = midY - (h / 2);
    display.drawRect(0, startY, SCREEN_WIDTH, h, WHITE);
    display.display();
    delay(15);
  }
  delay(200); 
}
void setup() {
  Serial.begin(115200);
  
  pinMode(PIN_LEFT, INPUT);
  pinMode(PIN_RIGHT, INPUT);
  pinMode(PIN_SELECT, INPUT);
  pinMode(PIN_SEND, INPUT);

  if(!display.begin(SSD1306_SWITCHCAPVCC, 0x3C)) for(;;);
    display.clearDisplay();
  drawScreen_3();
  delay(500);
  drawScreen_2(); 
  delay(2500);
  drawScreen_1(); 
  delay(1500);
  display.clearDisplay();
  display.setTextSize(1);
  display.setTextColor(SSD1306_WHITE);

  display.setCursor(0, 0);
  display.println("Connecting WiFi...");
  display.display();

  WiFi.begin(ssid, password);
  while (WiFi.status() != WL_CONNECTED) { delay(100); }

  server.on("/get_prompt", HTTP_GET, handleGetPrompt);
  server.on("/send", HTTP_POST, handlePostData);
  server.on("/send", HTTP_OPTIONS, handlePostData); 
  server.begin();

  Serial.print("ESP32 IP Address: ");
  Serial.println(WiFi.localIP());
  
  currentState = TYPING_PROMPT;
}

void loop() {
  server.handleClient();
  if (currentState == TYPING_PROMPT) {
    bool touchLeft   = (digitalRead(PIN_LEFT) == HIGH);
    bool touchRight  = (digitalRead(PIN_RIGHT) == HIGH);
    bool touchSelect = (digitalRead(PIN_SELECT) == HIGH);
    bool touchSend   = (digitalRead(PIN_SEND) == HIGH);

    if (touchLeft && !leftLatched) {
      cursorIndex = (cursorIndex > 0) ? cursorIndex - 1 : TOTAL_CHARS - 1;
      leftLatched = true;
      delay(50);
    } else if (!touchLeft) {
      leftLatched = false;
    }

    if (touchRight && !rightLatched) {
      cursorIndex = (cursorIndex < TOTAL_CHARS - 1) ? cursorIndex + 1 : 0;
      rightLatched = true;
      delay(50);
    } else if (!touchRight) {
      rightLatched = false;
    }

    if (touchSelect) {
      if (!isSelectPressed) {
        isSelectPressed = true;
        holdActionTriggered = false;
        selectTouchTime = millis();
      } else if (!holdActionTriggered && (millis() - selectTouchTime >= 2000)) {
        if (currentPrompt.length() > 0) {
          currentPrompt.remove(currentPrompt.length() - 1);
        }
        holdActionTriggered = true; 
      }
    } else {
      if (isSelectPressed) {
        if (!holdActionTriggered) {
          if (currentPrompt.length() < 40) { 
            currentPrompt += keyboard[cursorIndex];
          }
        }
        isSelectPressed = false;
      }
    }

    if (touchSend && !sendLatched) {
      if (currentPrompt.length() > 0) {
        promptReadyToSend = true;
        currentState = WAITING_FOR_AI; 
      }
      sendLatched = true;
    } else if (!touchSend) {
      sendLatched = false;
    }

    display.clearDisplay();
    display.setTextSize(1);
    
    display.setTextWrap(true); 
    display.setCursor(0, 0);
    display.print("> ");
    display.print(currentPrompt);
    
    display.drawFastHLine(0, 32, SCREEN_WIDTH, WHITE);

    display.setTextWrap(false);
    int displayIndexStart = cursorIndex - 3;
    for (int i = 0; i < 7; i++) {
      int targetIdx = displayIndexStart + i;
      if (targetIdx < 0) targetIdx += TOTAL_CHARS;
      if (targetIdx >= TOTAL_CHARS) targetIdx -= TOTAL_CHARS;
      
      int drawX = i * 18 + 4;
      int drawY = 46;

      if (i == 3) { 
        display.fillRect(drawX - 2, drawY - 2, 14, 13, WHITE);
        display.setTextColor(BLACK);
      } else {
        display.setTextColor(WHITE);
      }
      display.setCursor(drawX, drawY);
      display.print(keyboard[targetIdx]);
    }
    display.display();
  }

  else if (currentState == WAITING_FOR_AI) {
    display.clearDisplay();
    display.setTextWrap(true);
    display.setTextSize(1);
    display.setTextColor(WHITE);
    display.setCursor(10, 20);
    display.println("Prompt Dispatched...");
    display.setCursor(10, 35);
    display.println("Awaiting AI response");
    display.display();

    if (newTextAvailable) {
      currentState = SCROLLING_RESPONSE;
    }
    delay(50);
  }
  else if (currentState == SCROLLING_RESPONSE) {
    newTextAvailable = false;
    wrapTextToArray(currentText, 21); 
    smoothScrollText();
    delay(1500); 
    currentText = "";
    currentState = TYPING_PROMPT; 
  }

  delay(10);
}