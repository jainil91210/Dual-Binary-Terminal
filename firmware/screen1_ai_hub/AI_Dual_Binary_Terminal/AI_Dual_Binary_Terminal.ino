#include <WiFi.h>
#include <WebServer.h>
#include <Wire.h>
#include "Adafruit_MPR121.h"
#include <Adafruit_GFX.h>
#include <Adafruit_SSD1306.h>

#define SCREEN_WIDTH 128
#define SCREEN_HEIGHT 64
#define OLED_RESET -1
#define ENTER_BUTTON_PIN 15
#define HAPTIC_PIN 4

#define DIP1 23
#define DIP2 17
#define DIP3 16

TwoWire I2C_OLED = TwoWire(0);
TwoWire I2C_SENSOR = TwoWire(1);

Adafruit_SSD1306 display(SCREEN_WIDTH, SCREEN_HEIGHT, &I2C_OLED, OLED_RESET);
Adafruit_MPR121 cap = Adafruit_MPR121();

WebServer server(80);

const char* ssid = "12345678";
const char* password = "12345678";

const int NUM_LETTER_PADS = 7;

String uppercaseLetters[] = {
  "ABCD",
  "EFGH",
  "IJKL",
  "MNOP",
  "QRST",
  "UVW",
  "XYZ"
};

String lowercaseLetters[] = {
  "abcd",
  "efgh",
  "ijkl",
  "mnop",
  "qrst",
  "uvw",
  "xyz"
};

String numbersMap[] = {
  "1234",
  "5678",
  "90",
  "123",
  "456",
  "789",
  "0"
};

String specialMap[] = {
  "!@#$",
  "%^&*",
  "()[]",
  "{}<>",
  "+-=",
  "/?:",
  ".,_"
};

const int PAD_SPACE = 7;
const int PAD_BACKSPACE = 8;

// =========================
// TIMING
// =========================
const int TOUCH_THRESHOLD = 15;
const unsigned long TAP_WINDOW = 1000;
const unsigned long DEBOUNCE_TIME = 40;
const unsigned long REPEATED_TAP_DELAY = 220;
static const unsigned char PROGMEM image_DolphinMafia_bits[] = {0x00,0x00,0x00,0x00,0x0f,0xfc,0x00,0x00,0x00,0x00,0x00,0x00,0x00,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0x00,0x00};static const unsigned char PROGMEM image_paint_2_bits[] = {0x00,0x04,0x00,0x00,0x40,0x04,0x00,0x00,0x40,0x04,0x00,0x00,0x40,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0x02,0x00};
static const unsigned char PROGMEM image_BLE_Pairing_bits[] = {0x00,0x00,0x00,0x00,0x00,0x00,0x00,0x00,0x00,0x00,0x00,0x00,0x00,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0x00,0x68};
  
// [BEGIN lopaka generated]

static const unsigned char PROGMEM image_Attention_bits[] = {0x70,0x50,0x50,0x50,0x70,0x20,0x00,0x70};

static const unsigned char PROGMEM image_DoorRight_bits[] = {0x10,0x20,0x04,0x00,0x00,0x00,0x00,0x00,0x00,0x00,0x00,0x00,0x00,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0x3f,0xc0};

static const unsigned char PROGMEM image_DoorRight_copy_1_bits[] = {0x00,0x00,0x20,0x04,0x08,0x00,0x00,0x00,0x00,0x00,0x01,0x78,0x00,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0x00,0x01};

static const unsigned char PROGMEM image_Drive_bits[] = {0x07,0xff,0xff,0xff,0xff,0xff,0xff,0xff,0xff,0xff,0xf8,0x00,0x00,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0x00,0x00};

static const unsigned char PROGMEM image_Exp_module_connected_bits[] = {0x1f,0xc0,0x1f,0xc0,0x1f,0xc0,0x0a,0x80,0x1f,0xc0,0x20,0x20,0x5e,0xd0,0x9e,0xd0};

static const unsigned char PROGMEM image_Hashmark_bits[] = {0x14,0x14,0x7e,0x28,0xfc,0x50,0x50};

static const unsigned char PROGMEM image_Hidden_window_bits[] = {0x7f,0x80,0x7e,0x80,0x7f,0x80,0x40,0x80,0xfe,0x80,0x82,0x80,0x83,0x80,0xfe,0x00};

static const unsigned char PROGMEM image_music_sound_wave_bits[] = {0x00,0x00,0x00,0x02,0x00,0x00,0x02,0x20,0x00,0x02,0x20,0x00,0x02,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0x00,0x00};

static const unsigned char PROGMEM image_network_www_bits[] = {0x03,0xc0,0x0d,0xb0,0x32,0x4c,0x24,0x24,0x44,0x22,0x7f,0xfe,0x88,0x11,0x88,0x11,0x88,0x11,0x88,0x11,0x7f,0xfe,0x44,0x22,0x24,0x24,0x32,0x4c,0x0d,0xb0,0x03,0xc0};

static const unsigned char PROGMEM image_passport_left_bits[] = {0x3c,0x40,0x98,0xa4,0xa4,0x98,0x80,0x80,0xa0,0x90,0x88,0xa4,0x90,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0x4c,0x4c};

static const unsigned char PROGMEM image_passport_left_copy_1_bits[] = {0xf0,0x08,0x64,0x94,0x94,0x64,0x04,0x04,0x14,0x24,0x44,0x94,0x24,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0xc8,0xc8};

static const unsigned char PROGMEM image_RFIDBigChip_bits[] = {0x60,0x00,0x00,0x00,0x00,0x67,0xff,0xff,0xff,0xe0,0x48,0x00,0x00,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0xff,0xe0};

static const unsigned char PROGMEM image_Rpc_active_bits[] = {0xe0,0xac,0xe2,0x02,0x80,0x8e,0x6a,0x0e};

static const unsigned char PROGMEM image_SDcardMounted_bits[] = {0xff,0xe0,0xff,0x20,0xff,0xe0,0xff,0x20,0xff,0xe0,0xff,0x20,0xff,0xe0,0xe6,0x00};
unsigned long lastTapTime = 0;
unsigned long fingerLiftTime = 0;
unsigned long lastStateChangeTime[12] = {0};

int tapCount = 0;
int activePad = -1;

bool isCurrentlyTouched[12] = {false};
bool waitingForTimeout = false;

String currentPrompt = "";
bool promptReadyToSend = false;

String currentText = "";
bool newTextAvailable = false;

const int SCROLL_SPEED_DELAY = 35;
const int LINE_HEIGHT = 10;

String lines[120];
int lineCount = 0;

enum SystemState {
  TYPING_PROMPT,
  WAITING_FOR_AI,
  SCROLLING_RESPONSE
};

SystemState currentState = TYPING_PROMPT;

void haptic(int durationMs) {
  digitalWrite(HAPTIC_PIN, HIGH);
  delay(durationMs);
  digitalWrite(HAPTIC_PIN, LOW);
}

void strongHaptic() {
  haptic(180);
  delay(70);
  haptic(180);
}

void responseHaptic() {
  haptic(220);
  delay(90);
  haptic(220);
  delay(90);
  haptic(220);
}
String* getCurrentMap() {

  bool lowercaseMode = digitalRead(DIP1) == LOW;
  bool numbersMode = digitalRead(DIP2) == LOW;
  bool specialMode = digitalRead(DIP3) == LOW;

  if (numbersMode) {
    return numbersMap;
  }

  if (specialMode) {
    return specialMap;
  }

  if (lowercaseMode) {
    return lowercaseLetters;
  }

  return uppercaseLetters;
}

void handleGetPrompt() {

  server.sendHeader("Access-Control-Allow-Origin", "*");

  if (promptReadyToSend) {

    server.send(200, "text/plain", currentPrompt);

    currentPrompt = "";
    promptReadyToSend = false;
  }
  else {
    server.send(204, "text/plain", "");
  }
}

void handlePostData() {

  server.sendHeader("Access-Control-Allow-Origin", "*");

  if (server.hasArg("plain")) {

    currentText = server.arg("plain");
    currentText.trim();

    newTextAvailable = true;

    server.send(200, "text/plain", "OK");
  }
}

void wrapTextToArray(String text, int maxCharsPerLine) {

  lineCount = 0;

  int textLength = text.length();
  int currentPos = 0;

  while (currentPos < textLength && lineCount < 120) {

    if (currentPos + maxCharsPerLine >= textLength) {

      lines[lineCount] = text.substring(currentPos);
      lineCount++;
      break;
    }

    int spaceIdx = text.lastIndexOf(' ', currentPos + maxCharsPerLine);

    if (spaceIdx > currentPos) {

      lines[lineCount] = text.substring(currentPos, spaceIdx);
      currentPos = spaceIdx + 1;
    }
    else {

      lines[lineCount] = text.substring(currentPos, currentPos + maxCharsPerLine);
      currentPos += maxCharsPerLine;
    }

    lineCount++;
  }
}

void smoothScrollText() {

  int totalScrollHeight = lineCount * LINE_HEIGHT;

  for (int scrollPos = SCREEN_HEIGHT; scrollPos > -totalScrollHeight; scrollPos--) {

    server.handleClient();

    display.clearDisplay();

    for (int i = 0; i < lineCount; i++) {

      int lineYPos = scrollPos + (i * LINE_HEIGHT);

      if (lineYPos > -LINE_HEIGHT && lineYPos < SCREEN_HEIGHT) {

        display.setCursor(0, lineYPos);
        display.print(lines[i]);
      }
    }

    display.display();

    delay(SCROLL_SPEED_DELAY);
  }
}
void drawScreen_1(void) {

    display.clearDisplay();

    // DolphinMafia
    display.drawBitmap(0, 7, image_DolphinMafia_bits, 119, 62, 1);

    // string 2
    display.setTextColor(1);
    display.setTextWrap(false);
    display.setCursor(77, 22);
    display.print("Terminal");

    // string 3
    display.setCursor(100, 1);
    display.print("Dual");

    // string 4
    display.setCursor(88, 12);
    display.print("BINARY");

    display.display();
}
void drawScreen_2(void) {

    display.clearDisplay();

    // RFIDBigChip
    display.drawBitmap(46, 14, image_RFIDBigChip_bits, 37, 36, 1);

    // passport_left
    display.drawBitmap(40, 7, image_passport_left_bits, 6, 46, 1);

    // passport_left copy 1
    display.drawBitmap(83, 7, image_passport_left_copy_1_bits, 6, 46, 1);

    // line 4
    display.drawLine(46, 7, 84, 7, 1);

    // Drive
    display.drawBitmap(18, 52, image_Drive_bits, 112, 35, 1);

    // DoorRight
    display.drawBitmap(0, 3, image_DoorRight_bits, 40, 47, 1);

    // DoorRight copy 1
    display.drawBitmap(89, 3, image_DoorRight_copy_1_bits, 40, 47, 1);

    // Exp_module_connected
    display.drawBitmap(23, 54, image_Exp_module_connected_bits, 12, 8, 1);

    // Hidden_window
    display.drawBitmap(40, 54, image_Hidden_window_bits, 9, 8, 1);

    // line 11
    display.drawLine(34, 5, 93, 5, 1);

    // Rpc_active
    display.drawBitmap(55, 54, image_Rpc_active_bits, 7, 8, 1);

    // SDcardMounted
    display.drawBitmap(68, 54, image_SDcardMounted_bits, 11, 8, 1);

    // Hashmark
    display.drawBitmap(85, 54, image_Hashmark_bits, 7, 7, 1);

    // Attention
    display.drawBitmap(98, 54, image_Attention_bits, 5, 8, 1);

    // network_www
    display.drawBitmap(1, 47, image_network_www_bits, 16, 16, 1);

    // music_sound_wave
    display.drawBitmap(108, 43, image_music_sound_wave_bits, 17, 16, 1);

    display.display();
}

void drawScreen_3(void){
    display.clearDisplay();
  
  int midX = SCREEN_WIDTH / 2;
  int midY = SCREEN_HEIGHT / 2;

  display.drawPixel(midX, midY, WHITE);
  display.display();
  delay(400);

  for (int w = 1; w <= SCREEN_WIDTH; w += 8) {
    display.clearDisplay();
    int startX = midX - (w / 2);
    display.drawFastHLine(startX, midY, w, WHITE);
    display.display();
    delay(15); 
  }
  delay(100); 

  for (int h = 1; h <= SCREEN_HEIGHT; h += 4) {
    display.clearDisplay();
    int startY = midY - (h / 2);
    display.drawRect(0, startY, SCREEN_WIDTH, h, WHITE);
    display.display();
    delay(15);
  }
  delay(200); 
}
void setup() {

  Serial.begin(115200);

  pinMode(ENTER_BUTTON_PIN, INPUT_PULLUP);
  pinMode(HAPTIC_PIN, OUTPUT);

  pinMode(DIP1, INPUT_PULLUP);
  pinMode(DIP2, INPUT_PULLUP);
  pinMode(DIP3, INPUT_PULLUP);

  I2C_OLED.begin(21, 22, 400000);
  I2C_SENSOR.begin(18, 19, 100000);

  display.begin(SSD1306_SWITCHCAPVCC, 0x3C);
  cap.begin(0x5A, &I2C_SENSOR);
if(!display.begin(SSD1306_SWITCHCAPVCC, 0x3C)) for(;;);
    display.clearDisplay();
  drawScreen_3();
  delay(500);
  drawScreen_2(); 
  delay(2500);
  drawScreen_1(); 
  delay(1500);
  display.clearDisplay();
  display.setTextSize(1);
  display.setTextColor(SSD1306_WHITE);

  display.setCursor(0, 20);
  display.println("Connecting WiFi...");
  display.display();

  WiFi.begin(ssid, password);

  while (WiFi.status() != WL_CONNECTED) {
    delay(100);
  }

  server.on("/get_prompt", HTTP_GET, handleGetPrompt);
  server.on("/send", HTTP_POST, handlePostData);

  server.begin();
}

void loop() {

  server.handleClient();

  unsigned long currentTime = millis();

  if (currentState == TYPING_PROMPT) {

    String* currentMap = getCurrentMap();

    for (int i = 0; i < 12; i++) {

      int rawValue = cap.filteredData(i);

      if (rawValue <= TOUCH_THRESHOLD) {

        if (!isCurrentlyTouched[i] &&
            (currentTime - lastStateChangeTime[i] > DEBOUNCE_TIME)) {

          isCurrentlyTouched[i] = true;

          lastStateChangeTime[i] = currentTime;

          // LETTERS
          if (i < NUM_LETTER_PADS) {

            if (activePad == i) {

              if (currentTime - fingerLiftTime > REPEATED_TAP_DELAY) {

                currentPrompt += (*(currentMap + activePad))[
                  ((tapCount - 1) % (*(currentMap + activePad)).length())
                ];

                strongHaptic();

                tapCount = 1;
              }
              else {
                tapCount++;
              }
            }
            else {

              if (waitingForTimeout) {

                currentPrompt += (*(currentMap + activePad))[
                  ((tapCount - 1) % (*(currentMap + activePad)).length())
                ];

                strongHaptic();
              }

              activePad = i;
              tapCount = 1;
            }

            lastTapTime = currentTime;
            waitingForTimeout = true;
          }

          // SPACE
          else if (i == PAD_SPACE) {

            if (waitingForTimeout) {

              currentPrompt += (*(currentMap + activePad))[
                ((tapCount - 1) % (*(currentMap + activePad)).length())
              ];

              waitingForTimeout = false;
            }

            currentPrompt += " ";

            strongHaptic();

            tapCount = 0;
            activePad = -1;
          }

          // BACKSPACE
          else if (i == PAD_BACKSPACE) {

            waitingForTimeout = false;

            tapCount = 0;
            activePad = -1;

            if (currentPrompt.length() > 0) {
              currentPrompt.remove(currentPrompt.length() - 1);
            }
          }
        }
      }
      else {

        if (isCurrentlyTouched[i] &&
            (currentTime - lastStateChangeTime[i] > DEBOUNCE_TIME)) {

          isCurrentlyTouched[i] = false;

          lastStateChangeTime[i] = currentTime;

          if (i < NUM_LETTER_PADS) {
            fingerLiftTime = currentTime;
          }
        }
      }
    }

    static bool lastButtonState = HIGH;

    bool currentButtonState = digitalRead(ENTER_BUTTON_PIN);

    if (lastButtonState == HIGH && currentButtonState == LOW) {

      delay(20);

      if (digitalRead(ENTER_BUTTON_PIN) == LOW) {

        responseHaptic();

        if (waitingForTimeout) {

          currentPrompt += (*(currentMap + activePad))[
            ((tapCount - 1) % (*(currentMap + activePad)).length())
          ];

          waitingForTimeout = false;
        }

        if (currentPrompt.length() > 0) {

          promptReadyToSend = true;
          currentState = WAITING_FOR_AI;
        }

        tapCount = 0;
        activePad = -1;
      }
    }

    lastButtonState = currentButtonState;

    if (waitingForTimeout &&
        (currentTime - lastTapTime > TAP_WINDOW)) {

      if (tapCount > 0 && activePad != -1) {

        currentPrompt += (*(currentMap + activePad))[
          ((tapCount - 1) % (*(currentMap + activePad)).length())
        ];

        strongHaptic();
      }

      tapCount = 0;
      activePad = -1;
      waitingForTimeout = false;
    }

    display.clearDisplay();

    display.setTextSize(1);
    display.setTextColor(SSD1306_WHITE);

    display.setCursor(0, 0);

    display.print("> ");

    String previewPrompt = currentPrompt;

    if (waitingForTimeout && activePad != -1) {

      previewPrompt += (*(currentMap + activePad))[
        ((tapCount - 1) % (*(currentMap + activePad)).length())
      ];
    }

    display.print(previewPrompt);

    if (currentTime % 1000 < 500) {
      display.print("_");
    }

    display.display();
  }

  else if (currentState == WAITING_FOR_AI) {

    display.clearDisplay();

    display.setCursor(10, 25);
    display.println("Sending Prompt...");

    display.display();

    if (newTextAvailable) {

      responseHaptic();

      currentState = SCROLLING_RESPONSE;
    }

    delay(50);
  }

  else if (currentState == SCROLLING_RESPONSE) {

    newTextAvailable = false;

    wrapTextToArray(currentText, 21);

    smoothScrollText();

    delay(1500);

    currentText = "";

    currentState = TYPING_PROMPT;
  }

  delay(5);
}